## build/Kconfig/arch/Kconfig
```kconfig
# Load Zephyr Arch Kconfig descriptions.
osource "/home/matt/ncs/zephyr/arch/x86/Kconfig"
osource "/home/matt/ncs/zephyr/arch/xtensa/Kconfig"
osource "/home/matt/ncs/zephyr/arch/sparc/Kconfig"
osource "/home/matt/ncs/zephyr/arch/riscv/Kconfig"
osource "/home/matt/ncs/zephyr/arch/posix/Kconfig"
osource "/home/matt/ncs/zephyr/arch/nios2/Kconfig"
osource "/home/matt/ncs/zephyr/arch/mips/Kconfig"
osource "/home/matt/ncs/zephyr/arch/arm64/Kconfig"
osource "/home/matt/ncs/zephyr/arch/arm/Kconfig"
osource "/home/matt/ncs/zephyr/arch/arc/Kconfig"
```

## build/Kconfig/boards/Kconfig
```kconfig
# Load Zephyr board Kconfig descriptions.
osource "/home/matt/ncs/zephyr/boards/nordic/nrf52840dongle/Kconfig"
```

## build/Kconfig/boards/Kconfig.defconfig
```kconfig
# Load Zephyr board defconfig descriptions.
osource "/home/matt/ncs/zephyr/boards/nordic/nrf52840dongle/Kconfig.defconfig"
```

## build/Kconfig/boards/Kconfig.nrf52840dongle
```kconfig
# Load board Kconfig descriptions.
osource "/home/matt/ncs/zephyr/boards/nordic/nrf52840dongle/Kconfig.nrf52840dongle"
```
